## config/west.yml
```yaml
manifest:
  remotes:
    - name: zmkfirmware
      url-base: https://github.com/zmkfirmware
    - name: caksoylar
      url-base: https://github.com/caksoylar
    # - name: inorichi
    #   url-base: https://github.com/inorichi
    - name: cormoran
      url-base: https://github.com/cormoran
    - name: imo00o
      url-base: https://github.com/imo00o
  projects:
    #　- name: zmk
    #   remote: zmkfirmware
    #   revision: v0.3.0
    - name: zmk
      remote: cormoran
      revision: v0.3-branch+dya
      import: app/west.yml
    - name: zmk-pmw3610-driver
      remote: imo00o
      revision: feature/delay
    - name: zmk-rgbled-widget
      remote: caksoylar
      revision: v0.3.0
    # DYA Studio モジュール
    - name: zmk-module-ble-management
      remote: cormoran
      revision: main
    - name: zmk-module-battery-history
      remote: cormoran
      revision: main
    - name: zmk-module-settings-rpc
      remote: cormoran
      revision: main
    - name: zmk-module-runtime-input-processor
      remote: cormoran
      revision: main
    - name: zmk-behavior-runtime-sensor-rotate
      remote: cormoran
      revision: main
  self:
    path: config
```
